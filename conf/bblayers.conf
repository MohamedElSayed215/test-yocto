## conf/bblayers.conf
```bitbake
# BBLAYERS configuration file
# This file was created by the OpenEmbedded build system.

BBLAYERS ?= " \
  ${TOPDIR}/../poky/meta \
  ${TOPDIR}/../poky/meta-poky \
  ${TOPDIR}/../poky/meta-yocto-bsp \
  ${TOPDIR}/../meta-raspberrypi \
  ${TOPDIR}/../meta-openembedded/meta-oe \
  ${TOPDIR}/../meta-openembedded/meta-multimedia \
  ${TOPDIR}/../meta-openembedded/meta-networking \
  ${TOPDIR}/../meta-openembedded/meta-python \
"
```

## conf/local.conf
```bitbake
# Local.conf for Raspberry Pi 4 with docker, ssh, python, libcamera, gstreamer, nano

MACHINE ?= "raspberrypi4"

# Use systemd init system
DISTRO_FEATURES_remove := "x11 wayland"
DISTRO_FEATURES_append := " systemd bluetooth wifi virtual/kernel opengl docker ssh-server-openssh"

# Image to build
IMAGE_FSTYPES = "wic.bz2"

# Enable packages
EXTRA_IMAGE_FEATURES = "debug-tweaks"

# Package installation
IMAGE_INSTALL_append = " python3 nano libcamera gstreamer1.0 gstreamer1.0-plugins-base gstreamer1.0-plugins-good"

# Enable SSH root login
SSH_ENABLE = "1"

# Docker settings
DISTRO_FEATURES_append += " virtualization"

# Increase parallel make jobs for faster build (adjust to runner)
BB_NUMBER_THREADS ?= "4"
PARALLEL_MAKE ?= "-j 4"

# Extra Kernel Modules if needed (optional)
# KERNEL_MODULE_AUTOLOAD += "..."

# Set timezone (optional)
# TIMEZONE = "UTC"

# Uncomment to enable WiFi country setting
# WIRELESS_COUNTRY = "US"
```

## meta-rpi-custom/conf/layer.conf
```bitbake
# meta-your-project/conf/layer.conf

BBPATH .= ":${LAYERDIR}"
BBFILES += "${LAYERDIR}/recipes-*/*/*.bb"

LAYERSERIES_COMPAT_meta-your-project = "kirkstone"
```

## rpi-test-image/conf/local.conf
```bitbake
MACHINE = "raspberrypi3"
DISTRO = "poky"
DISTRO_FEATURES_append = " wifi ethernet ssh"
EXTRA_IMAGE_FEATURES = "ssh-server-openssh"
IMAGE_FSTYPES = "wic img"
CORE_IMAGE_EXTRA_INSTALL = "openssh wpa-supplicant networkmanager raspberrypi-firmware rpi-test-image"
```
